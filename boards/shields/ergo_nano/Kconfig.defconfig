## boards/shields/ergo_nano/Kconfig.shield
```kconfig
config SHIELD_ERGO_NANO_LEFT
    def_bool $(shields_list_contains,ergo_nano_left)

config SHIELD_ERGO_NANO_RIGHT
    def_bool $(shields_list_contains,ergo_nano_right)
```
